// SPDX-License-Identifier: BSD-3-Clause
/*
 * Copyright (c) 2023, Qualcomm Innovation Center, Inc. All rights reserved.
 * Copyright (c) 2025, Linaro Limited
 * Copyright (c) 2025, Zimo Zhang
 */

/dts-v1/;

#include "x1e78100-acer-sfa14-11.dts"

// extra fields, should be merged with base device tree after test
&{/} {

};
